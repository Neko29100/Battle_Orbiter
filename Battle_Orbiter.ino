// BATTLE ORBITER - Game Jam 3
// taniguchi kotaro
// https://www.youtube.com/c/kotarotaniguchix
#include <Arduboy2.h>
Arduboy2 display;

void setup() {
  display.begin();
}

PROGMEM const unsigned char bitmap_star [2][8 * 128] = {
  {
    0x00, 0x00, 0x00, 0x00, 0x00, 0x00, 0x00, 0x00,
    0x00, 0x00, 0x00, 0x00, 0x00, 0x00, 0x00, 0x00,
    0x00, 0x00, 0x00, 0x00, 0x00, 0x00, 0x00, 0x00,
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    0x00, 0x00, 0x00, 0x00, 0x00, 0x00, 0x00, 0x00,
  },
  {
    0x00, 0x00, 0x00, 0x00, 0x00, 0x00, 0x00, 0x00,
    0x00, 0x00, 0x00, 0x00, 0x00, 0x00, 0x00, 0x00,
    0x00, 0x00, 0x00, 0x00, 0x00, 0x00, 0x00, 0x00,
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    0x00, 0x00, 0x00, 0x00, 0x00, 0x00, 0x00, 0x00,

  },
};

PROGMEM const unsigned char bitmap_star_man [2][8 * 128] = {
  {
    0x00, 0x00, 0x00, 0x00, 0x00, 0x00, 0x00, 0x00,
    0x00, 0x00, 0x00, 0x00, 0x00, 0x00, 0x00, 0x00,
    0x00, 0x00, 0x00, 0x00, 0x00, 0x00, 0x00, 0x00,
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    0x00, 0x00, 0x00, 0x00, 0x00, 0x00, 0x00, 0x00,

  },
  {
    0x00, 0x00, 0x00, 0x00, 0x00, 0x00, 0x00, 0x00,
    0x00, 0x00, 0x00, 0x00, 0x00, 0x00, 0x00, 0x00,
    0x00, 0x00, 0x00, 0x00, 0x00, 0x00, 0x00, 0x00,
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    0x00, 0x00, 0x00, 0x00, 0x00, 0x00, 0x00, 0x00,

  },
};

PROGMEM const unsigned char bitmap_wakusei [6][8 * 128] = {
  {
    0x00, 0x00, 0x00, 0x00, 0x00, 0x00, 0x00, 0x00,
    0x00, 0x00, 0x00, 0x00, 0x00, 0x00, 0x00, 0x00,
    0x00, 0x00, 0x00, 0x00, 0x00, 0x00, 0x00, 0x00,
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    0x00, 0x00, 0x00, 0x00, 0x00, 0x00, 0x00, 0x00,
  },
  {
    0x00, 0x00, 0x00, 0x00, 0x00, 0x00, 0x00, 0x00,
    0x00, 0x00, 0x00, 0x00, 0x00, 0x00, 0x00, 0x00,
    0x00, 0x00, 0x00, 0x00, 0x00, 0x00, 0x00, 0x00,
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    0x00, 0x00, 0x00, 0x00, 0x00, 0x00, 0x00, 0x00,
  },
  {
    0x00, 0x00, 0x00, 0x00, 0x00, 0x00, 0x00, 0x00,
    0x00, 0x00, 0x00, 0x00, 0x00, 0x00, 0x00, 0x00,
    0x00, 0x00, 0x00, 0x00, 0x00, 0x00, 0x00, 0x00,
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    0x00, 0x00, 0x00, 0x00, 0x00, 0x00, 0x00, 0x00,

  },
  {
    0x00, 0x00, 0x00, 0x00, 0x00, 0x00, 0x00, 0x00,
    0x00, 0x00, 0x00, 0x00, 0x00, 0x00, 0x00, 0x00,
    0x00, 0x00, 0x00, 0x00, 0x00, 0x00, 0x00, 0x00,
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    0x00, 0x00, 0x00, 0x00, 0x00, 0x00, 0x00, 0x00,

  },
  {
    0x00, 0x00, 0x00, 0x00, 0x00, 0x00, 0x00, 0x00,
    0x00, 0x00, 0x00, 0x00, 0x00, 0x00, 0x00, 0x00,
    0x00, 0x00, 0x00, 0x00, 0x00, 0x00, 0x00, 0x00,
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    0x00, 0x00, 0x00, 0x00, 0x00, 0x00, 0x00, 0x00,

  },
  {
    0x00, 0x00, 0x00, 0x00, 0x00, 0x00, 0x00, 0x00,
    0x00, 0x00, 0x00, 0x00, 0x00, 0x00, 0x00, 0x00,
    0x00, 0x00, 0x00, 0x00, 0x00, 0x00, 0x00, 0x00,
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    0x00, 0x00, 0x00, 0x00, 0x00, 0x00, 0x00, 0x00,

  },
};


PROGMEM const unsigned char bitmap_fighter[4][24] = {
  {
    0b01110000,
    0b01110000,
    0b01110000,
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    0b11000000,
    0b10000000
  },
  {
    0b00001110,
    0b00001110,
    0b00001110,
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    0b00000001,
  },
  {
    0b01110000,
    0b01110000,
    0b01110000,
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    0b11000000,
    0b10000000
  },
  {
    0b00001110,
    0b00001110,
    0b00001110,
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    0b00000001,
  }
};

PROGMEM const unsigned char bitmap_gun[2][4][24] = {
  {
    {
      0b00000000,
      0b00000000,
      0b00000000,
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      0b00001000,
    },
    {
      0b00000000,
      0b00000000,
      0b00000000,
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      0b00010000,
    },
    {
      0b00000000,
      0b00000000,
      0b00000000,
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      0b00001000,
    },
    {
      0b00000000,
      0b00000000,
      0b00000000,
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      0b00010000,
    },
  },
  {
    {
      0b00001000,
      0b00001000,
      0b00001100,
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      0b00000000,
    },
    {
      0b00010000,
      0b00010000,
      0b00110000,
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      0b00000000,

    },
    {
      0b00001000,
      0b00001000,
      0b00001100,
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      0b00000000,
    },
    {
      0b00010000,
      0b00010000,
      0b00110000,
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      0b00000000,

    },
  },
};

PROGMEM const unsigned char bitmap_subjet[4][8] = {
  {
    0b00000000,
    0b00000000,
    0b00000000,
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    0b00000000,
  },
  {
    0b00000000,
    0b00000000,
    0b00000000,
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    0b00000000,
  },
  {
    0b00000000,
    0b00000000,
    0b00000000,
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    0b00001000,
  },
  {
    0b00001000,
    0b00011100,
    0b00001000,
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    0b00000000,
  },
};

PROGMEM const unsigned char bitmap_jet[3][8] = {
  {
    0b00000000,
    0b00100000,
    0b00100000,
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    0b00100000,
  },
  {
    0b00000000,
    0b00000100,
    0b00000100,
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    0b00000100,
  },
  {
    0b00011000,
    0b00100100,
    0b01100110,
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    0b00001000,
  },
};

PROGMEM const unsigned char bitmap_enemy[2][2][16] = {
  {
    {
      0b00000000,
      0b00000000,
      0b00111000,
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      0b00000000,
    },
    {
      0b00000000,
      0b00100000,
      0b01010000,
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      0b00100000,
    }
  },
  {
    {
      0b00000000,
      0b01110000,
      0b10001000,
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      0b00000000,
    },
    {
      0b00010000,
      0b01101000,
      0b10001000,
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      0b00000000,
    }
  },
};

PROGMEM const unsigned char bitmap_tama[8] = {
  0b00000000,
  0b00000000,
  0b00011000,
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  0b00000000,
};

PROGMEM const unsigned char bitmap_boss[8 * 128] =
{
  0x00, 0x00, 0x00, 0x00, 0x00, 0x00, 0x00, 0x00,
  0x00, 0x00, 0x00, 0x00, 0x00, 0x00, 0x00, 0x00,
  0x00, 0x00, 0x00, 0x00, 0x00, 0x00, 0x00, 0x00,
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  0x00, 0x00, 0x00, 0x00, 0x00, 0x00, 0x00, 0x00,

};

PROGMEM const unsigned char bitmap_bakuhatu[8 * 128] =
{
0x00, 0x00, 0x00, 0x00, 0x00, 0x00, 0x00, 0x00, 
0x00, 0x00, 0x00, 0x00, 0x00, 0x00, 0x00, 0x00, 
0x00, 0x00, 0x00, 0x00, 0x00, 0x00, 0x00, 0x00, 
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0x00, 0x00, 0x00, 0x00, 0x00, 0x00, 0x00, 0x00, 

};

enum game_state {
  state_help,
  state_menu,
  state_game_bef,
  state_game,
  state_game_aft,
  state_game_clear,
  state_game_over_enemy,
  state_game_over_speed,
};
enum game_state state = state_menu;

bool now_push_a = false;
bool now_push_b = false;
bool now_push_u = false;
bool now_push_d = false;
bool now_push_l = false;
bool now_push_r = false;

unsigned long currTime;
unsigned long prevTime = 0;
#define FPSDELAY      1000/30

typedef struct pos {
  int x;
  int y;
  int add_x;
  int add_y;
  int add_x_man;
} POS;

POS cur = {0};
POS cur_tama[20] = {0};

POS cur_enemy[6] = {0};

bool gun_enable = true;
int tama_kakudo = 3;
int tama_count = 99;
int tama_index = 0;

int wakusei_x = 0;

POS cur_star = {0};
int cur_star_x_tyosei = 0;
int cur_star_y_tyosei = 0;
int cur_star_man_x = 0;
int cur_star_man_y = 0;
int cur_star_index = 0;
int cur_star_man_index = 0;
int cur_star_index_mawari[2][3] = {
  {1, 0, 1},
  {0, 1, 0},
};

int subjet_u = 0;
int subjet_d = 0;
int subjet_r = 0;
int subjet_l = 0;
int jet_r = 0;
int jet_l = 0;
int jet_r_count = 0;
int jet_l_count = 0;

int distance_x = 9999;
int distance_x_man = 9999;
int distance_x_oku = 99;

bool jet_kosyo = false;

struct {
  int start_wakusei;
  int goal_wakusei;
  int enemy_hindo;
  int start_add_x;
  bool gun;
  bool jet_kosyo;
  int oku;
  int man;
}  stage_conf[7] {
  {0, 1, 200, -2, false, false, 16, 2940}, // 武器なし
  {1, 2, 200, -2, true, false, 14, 4560},  // 武器あり
  {2, 3, 100, -2, true, false,  6, 5110},  // 武器あり
  {3, 4, 200, -2, true, true,  5, 5040},  // エンジン故障
  {4, 5, 50, -2, true, false,  0, 7830},  // 敵多め
  {5, 0, 30, -2, true, false,  0,    1},  // 敵多め
};
int now_stage = 0;

void loop() {

  int enemy_count = 0;

  while (true) {
    currTime = millis();
    if ( currTime > prevTime + FPSDELAY ) {
      prevTime = currTime;
      byte input = display.buttonsState();
      display.clear();
      switch (state) {
        case state_help:
          display.setCursor(0, 0);  display.print(F("HELP"));
          display.setCursor(0, 16);  display.print(F("A:Move rail gun"));
          display.setCursor(0, 24);  display.print(F("B:Rail gun"));
          display.setCursor(0, 32);  display.print(F("Long press:Main Jet"));
          display.setCursor(0, 48);  display.print(F("Arriving at overspeed:"));
          display.setCursor(0, 56);  display.print(F("    Planet breaks"));
          if (input & B_BUTTON) {
            now_push_b = true;
          } else {
            if (now_push_b) {
              now_push_b = false;
              state = state_menu;
            }
          }

          break;
        case state_menu:
          display.drawBitmap(0, 0, bitmap_wakusei[stage_conf[now_stage].start_wakusei], 128, 64, 1);
          display.setCursor(20, 28);  display.print(F("BATTLE ORBITER"));
          display.setCursor(0, 64 - 8);  display.print(F("A:HELP B:START"));

          if (input & A_BUTTON) {
            now_push_a = true;
          } else {
            if (now_push_a) {
              now_push_a = false;
              state = state_help;
            }
          }

          if (input & B_BUTTON) {
            now_push_b = true;
          } else {
            if (now_push_b) {
              now_push_b = false;

              //初期設定
              for (int i = 0; i < 20; i++) {
                cur_tama[i].x = -8;
                cur_tama[i].add_x = 0;
                cur_tama[i].y = 0;
              }
              for (int i = 0; i < 3; i++) {
                cur_enemy[i].x = -16;
                cur_enemy[i].add_x = 0;
                cur_enemy[i].y = 8 + i * 16;
              }
              distance_x_man = stage_conf[now_stage].man;
              distance_x_oku = stage_conf[now_stage].oku;
              distance_x     = 0;
              cur.x = 8;
              cur.y = 24;
              cur.add_x = 0;
              cur.add_x_man = 0;
              cur.add_y = 0;
              cur_star.add_x = stage_conf[now_stage].start_add_x;
              cur_star.add_x_man = 0;
              wakusei_x = 64;
              jet_kosyo = stage_conf[now_stage].jet_kosyo;
              enemy_count = 150;
              gun_enable = stage_conf[now_stage].gun;
              tama_kakudo = 3;
              tama_count = 99;
              randomSeed(currTime & 0xFF);

              state = state_game_bef;
            }
          }
          break;
        case state_game_bef:
          if (wakusei_x > -128) {

            display.drawBitmap(wakusei_x * 2 - 128 * 2   , 0,      bitmap_star_man[0], 128, 64, 1);
            display.drawBitmap(wakusei_x * 2 - 128   , 0,      bitmap_star_man[1], 128, 64, 1);
            display.drawBitmap(wakusei_x * 2      , 0,      bitmap_star_man[0], 128, 64, 1);
            display.drawBitmap(wakusei_x * 2 + 128, 0,      bitmap_star_man[1], 128, 64, 1);
            display.drawBitmap(wakusei_x * 2 + 128 * 2, 0,      bitmap_star_man[0], 128, 64, 1);
            display.drawBitmap(wakusei_x * 3 - 128 * 3, 0,      bitmap_star[1], 128, 64, 1);
            display.drawBitmap(wakusei_x * 3 - 128 * 2, 0,      bitmap_star[0], 128, 64, 1);
            display.drawBitmap(wakusei_x * 3 - 128, 0,      bitmap_star[1], 128, 64, 1);
            display.drawBitmap(wakusei_x * 3      , 0,      bitmap_star[0], 128, 64, 1);
            display.drawBitmap(wakusei_x * 3 + 128, 0,      bitmap_star[1], 128, 64, 1);
            display.drawBitmap(wakusei_x * 3 + 128 * 2, 0,      bitmap_star[0], 128, 64, 1);
            display.drawBitmap(wakusei_x * 3 + 128 * 3, 0,      bitmap_star[1], 128, 64, 1);

            display.drawBitmap(wakusei_x, 0, bitmap_wakusei[stage_conf[now_stage].start_wakusei], 128, 64, 1);

            display.drawBitmap(cur.x, cur.y, bitmap_fighter[0], 24, 8, 0);
            display.drawBitmap(cur.x, cur.y + 8, bitmap_fighter[1], 24, 8, 0);
            display.drawBitmap(cur.x, cur.y, bitmap_fighter[2], 24, 8, 1);
            display.drawBitmap(cur.x, cur.y + 8, bitmap_fighter[3], 24, 8, 1);

            if (gun_enable) {
              if (tama_kakudo > 0) {
                display.drawBitmap(cur.x, cur.y, bitmap_gun[0][0], 24, 8, 0);
                display.drawBitmap(cur.x, cur.y + 8, bitmap_gun[0][1], 24, 8, 0);
                display.drawBitmap(cur.x, cur.y, bitmap_gun[0][2], 24, 8, 1);
                display.drawBitmap(cur.x, cur.y + 8, bitmap_gun[0][3], 24, 8, 1);
              } else {
                display.drawBitmap(cur.x, cur.y, bitmap_gun[1][0], 24, 8, 0);
                display.drawBitmap(cur.x, cur.y + 8, bitmap_gun[1][1], 24, 8, 0);
                display.drawBitmap(cur.x, cur.y, bitmap_gun[1][2], 24, 8, 1);
                display.drawBitmap(cur.x, cur.y + 8, bitmap_gun[1][3], 24, 8, 1);
              }
            }

            switch (now_stage) {
              case 1: display.setCursor(0, 0);  display.print(F("Rail gun Equipped")); break;
              case 3: display.setCursor(0, 0);  display.print(F("Main jet failure"));; break;
            }

            display.setCursor(0, 64 - 8);
            switch (now_stage) {
              case 0: display.print(F("Neptune")); break;
              case 1: display.print(F("Uranus")); break;
              case 2: display.print(F("Saturn")); break;
              case 3: display.print(F("Jupiter")); break;
              case 4: display.print(F("Mars")); break;
              case 5: display.print(F("Earth")); break;
            }

            wakusei_x -= 2;
          } else {
            state = state_game;
          }

          break;
        case state_game:
          if (input & LEFT_BUTTON) {
            now_push_l = true;
            if (jet_l_count < 10 && !jet_kosyo) {
              jet_l_count++;
              if (jet_l_count >= 10) {
                jet_l = 10;
                cur_star.add_x_man++;
              }
            }
          } else {
            if (now_push_l) {
              now_push_l = false;
              if (jet_l_count < 10) {
                subjet_l = 10;
                cur.add_x--;
              }
              jet_l_count = 0;
            }
          }
          if (input & RIGHT_BUTTON) {
            now_push_r = true;
            if (jet_r_count < 10 && !jet_kosyo) {
              jet_r_count++;
              if (jet_r_count >= 10) {
                jet_r = 10;
                cur_star.add_x_man--;
              }
            }
          } else {
            if (now_push_r) {
              now_push_r = false;
              if (jet_r_count < 10) {
                subjet_r = 10;
                cur.add_x++;
              }
              jet_r_count = 0;
            }
          }
          if (input & UP_BUTTON) {
            if (!now_push_u) {
              now_push_u = true;
              subjet_u = 10;
              cur.add_y--;
            }
          } else {
            now_push_u = false;
          }
          if (input & DOWN_BUTTON) {
            if (!now_push_d) {
              now_push_d = true;
              subjet_d = 10;
              cur.add_y++;
            }
          } else {
            now_push_d = false;
          }

          if (input & A_BUTTON) {
            if (!now_push_a) {
              now_push_a = true;
              tama_kakudo *= -1;
            }
          } else {
            now_push_a = false;
          }
          if (input & B_BUTTON) {
            if (!now_push_b) {
              now_push_b = true;

              if (gun_enable && tama_count > 0) {
                cur_tama[tama_index].x = cur.x + 8;
                cur_tama[tama_index].y = cur.y + 4;

                cur_tama[tama_index].add_x = tama_kakudo;
                cur_tama[tama_index].add_y = 0;

                if (jet_kosyo) {
                  cur_star.add_x_man += tama_kakudo;
                } else {
                  if (tama_kakudo > 0) {
                    jet_r = 10;
                  } else {
                    jet_l = 10;
                  }
                }

                tama_index++;
                if (tama_index >= 20) {
                  tama_index = 0;
                }
                tama_count--;
              }
            }
          } else {
            now_push_b = false;
          }

          cur.x += cur.add_x;
          cur.y += cur.add_y;
          if (cur.x < 8) {
            cur_star.x -= cur.x - 8;
            cur.x = 8;
            cur_star.add_x -= cur.add_x;
            cur.add_x = 0;
          }
          if (cur.x + 24 > 64) {
            cur_star.x -= (cur.x + 24 - 64);
            cur.x = 64 - 24;
            cur_star.add_x -= cur.add_x;
            cur.add_x = 0;
          }
          if (cur.y < 8) {
            cur.y = 8;
            cur.add_y = 0;
          }
          if (cur.y + 16 > 64 - 8) {
            cur.y = 64 - 8 - 16;
            cur.add_y = 0;
          }

          while (cur_star.add_x >= 10000) {
            cur_star.add_x_man++;
            cur_star.add_x -= 10000;
          }

          while (cur_star.add_x <= -10000) {
            cur_star.add_x_man--;
            cur_star.add_x += 10000;
          }
          if (cur_star.add_x < 0 && cur_star.add_x_man > 0) {
            cur_star.add_x_man--;
            cur_star.add_x += 10000;
          }

          distance_x += cur_star.add_x;
          distance_x_man += cur_star.add_x_man;

          while (distance_x >= 10000) {
            distance_x -= 10000;
            distance_x_man++;
          }
          while (distance_x_man >= 10000) {
            distance_x_man -= 10000;
            distance_x_oku++;
          }

          while (distance_x <= -10000) {
            distance_x += 10000;
            distance_x_man--;
          }
          if (distance_x < 0 && (distance_x_man > 0 || distance_x_oku > 0)) {
            distance_x += 10000;
            distance_x_man--;
          }
          while (distance_x_man <= -10000) {
            distance_x_man += 10000;
            distance_x_oku--;
          }
          if (distance_x_man < 0 && distance_x_oku > 0) {
            distance_x_man += 10000;
            distance_x_oku--;
          }

          if (cur_star.add_x_man > 0 || cur_star.add_x > 20) {
            cur_star.x += 20;
            cur_star_x_tyosei += 20;
          } else if (cur_star.add_x_man < 0 || cur_star.add_x < -20) {
            cur_star.x -= 20;
            cur_star_x_tyosei -= 20;
          } else {
            cur_star.x += cur_star.add_x;
            cur_star_x_tyosei += cur_star.add_x;
          }

          while (cur_star.x < 0) {
            switch (cur_star_index) {
              case 0: cur_star_index = 1; break;
              case 1: cur_star_index = 0; break;
            }
            cur_star.x += 128;
          }
          while (cur_star.x >= 128) {
            switch (cur_star_index) {
              case 0: cur_star_index = 1; break;
              case 1: cur_star_index = 0; break;
            }
            cur_star.x -= 128;
          }

          if (cur_star_x_tyosei >= 10000) {
            cur_star_x_tyosei = 0;
            cur_star_man_x++;
          } else if (cur_star_x_tyosei <= -10000) {
            cur_star_x_tyosei = 0;
            cur_star_man_x--;
          }


          if (cur_star.add_x_man > 20) {
            cur_star_man_x += 20;
          } else if (cur_star.add_x_man < -20) {
            cur_star_man_x -= 20;
          } else {
            if (cur_star.add_x_man != 0) {
              cur_star_man_x += cur_star.add_x_man;
            } else {
              if (cur_star.add_x > 0) { // 少しは動かす
                cur_star_man_x ++;
              } else if (cur_star.add_x < 0) {
                cur_star_man_x --;
              }
            }
          }
          while (cur_star_man_x < 0) {
            switch (cur_star_man_index) {
              case 0: cur_star_man_index = 1; break;
              case 1: cur_star_man_index = 0; break;
            }
            cur_star_man_x += 128;
          }
          while (cur_star_man_x >= 128) {
            switch (cur_star_man_index) {
              case 0: cur_star_man_index = 1; break;
              case 1: cur_star_man_index = 0; break;
            }
            cur_star_man_x -= 128;
          }

          display.drawBitmap(cur_star_man_x - 128, cur_star_man_y,      bitmap_star_man[cur_star_index_mawari[cur_star_man_index][0]], 128, 64, 1);
          display.drawBitmap(cur_star_man_x      , cur_star_man_y,      bitmap_star_man[cur_star_index_mawari[cur_star_man_index][1]], 128, 64, 1);
          display.drawBitmap(cur_star_man_x + 128, cur_star_man_y,      bitmap_star_man[cur_star_index_mawari[cur_star_man_index][2]], 128, 64, 1);

          display.drawBitmap(cur_star.x - 128, cur_star.y,      bitmap_star[cur_star_index_mawari[cur_star_index][0]], 128, 64, 1);
          display.drawBitmap(cur_star.x      , cur_star.y,      bitmap_star[cur_star_index_mawari[cur_star_index][1]], 128, 64, 1);
          display.drawBitmap(cur_star.x + 128, cur_star.y,      bitmap_star[cur_star_index_mawari[cur_star_index][2]], 128, 64, 1);

          if (gun_enable) {
            display.setCursor(0, 0);  display.print(F("bullets:"));
            display.print(tama_count);
          }


          if (abs(cur_star.add_x_man) > 10) {
            display.setCursor(64, 0);  display.print(F("overspeed!!"));

            if (distance_x < 0 || distance_x_man < 0 || distance_x_oku < 0) {
              // ゲームオーバー 激突
              if (now_stage < 5) {
                state = state_game_over_speed;
              } else {
                state = state_game_clear;
              }
            }
          } else {
            if (distance_x < 0 || distance_x_man < 0 || distance_x_oku < 0) {
              // クリア
              if (now_stage < 5) {
                wakusei_x = 128;
                state = state_game_aft;
              } else {
                state = state_game_over_enemy;
              }
            }
          }

          if (now_stage == 5 && (distance_x < 128 && distance_x_man == 0 && distance_x_oku == 0)) {
            display.drawBitmap(distance_x, 0, bitmap_boss, 128, 64, 1);
          }

          display.setCursor(0, 64 - 8);  display.print(F("distance:"));
          if (distance_x_oku != 0) {
            display.print(distance_x_oku);
            if (abs(distance_x_man) < 1000) {
              display.print(F("0"));
            }
            if (abs(distance_x_man) < 100) {
              display.print(F("0"));
            }
            if (abs(distance_x_man) < 10) {
              display.print(F("0"));
            }
            display.print(abs(distance_x_man));
            if (abs(distance_x) < 1000) {
              display.print(F("0"));
            }
            if (abs(distance_x) < 100) {
              display.print(F("0"));
            }
            if (abs(distance_x) < 10) {
              display.print(F("0"));
            }
            display.print(abs(distance_x));
          }
          else if (distance_x_man != 0) {
            display.print(distance_x_man);
            if (abs(distance_x) < 1000) {
              display.print(F("0"));
            }
            if (abs(distance_x) < 100) {
              display.print(F("0"));
            }
            if (abs(distance_x) < 10) {
              display.print(F("0"));
            }
            display.print(abs(distance_x));
          }
          else {
            display.print(distance_x);
          }
          display.print(F("km"));

          display.drawBitmap(cur.x, cur.y, bitmap_fighter[0], 24, 8, 0);
          display.drawBitmap(cur.x, cur.y + 8, bitmap_fighter[1], 24, 8, 0);
          display.drawBitmap(cur.x, cur.y, bitmap_fighter[2], 24, 8, 1);
          display.drawBitmap(cur.x, cur.y + 8, bitmap_fighter[3], 24, 8, 1);


          if (subjet_u > 0) {
            subjet_u--;
            display.drawBitmap(cur.x, cur.y + 16, bitmap_subjet[1], 8, 8, 1);
          }
          if (subjet_d > 0) {
            subjet_d--;
            display.drawBitmap(cur.x, cur.y - 8, bitmap_subjet[0], 8, 8, 1);
          }
          if (subjet_l > 0) {
            subjet_l--;
            display.drawBitmap(cur.x + 24, cur.y + 4, bitmap_subjet[3], 8, 8, 1);
          }
          if (subjet_r > 0) {
            subjet_r--;
            display.drawBitmap(cur.x - 8, cur.y + 4, bitmap_subjet[2], 8, 8, 1);
          }
          if (jet_l > 0) {
            jet_l--;
            display.drawBitmap(cur.x + 24, cur.y + 4, bitmap_jet[2], 8, 8, 1);

          }
          if (jet_r > 0) {
            jet_r--;
            display.drawBitmap(cur.x - 8, cur.y, bitmap_jet[0], 8, 8, 1);
            display.drawBitmap(cur.x - 8, cur.y + 8, bitmap_jet[1], 8, 8, 1);
          }

          if (gun_enable) {
            for (int i = 0; i < 20; i++) {
              cur_tama[i].x += cur_tama[i].add_x;
              if (cur_tama[i].x <= -8 || cur_tama[i].x >= 128) {
                cur_tama[i].x = -8;
                cur_tama[i].add_x = 0;
              }
              display.drawBitmap(cur_tama[i].x, cur_tama[i].y, bitmap_tama, 8, 8, 1);
            }
            if (tama_kakudo > 0) {
              display.drawBitmap(cur.x, cur.y, bitmap_gun[0][0], 24, 8, 0);
              display.drawBitmap(cur.x, cur.y + 8, bitmap_gun[0][1], 24, 8, 0);
              display.drawBitmap(cur.x, cur.y, bitmap_gun[0][2], 24, 8, 1);
              display.drawBitmap(cur.x, cur.y + 8, bitmap_gun[0][3], 24, 8, 1);
            } else {
              display.drawBitmap(cur.x, cur.y, bitmap_gun[1][0], 24, 8, 0);
              display.drawBitmap(cur.x, cur.y + 8, bitmap_gun[1][1], 24, 8, 0);
              display.drawBitmap(cur.x, cur.y, bitmap_gun[1][2], 24, 8, 1);
              display.drawBitmap(cur.x, cur.y + 8, bitmap_gun[1][3], 24, 8, 1);
            }
          }

          for (int i = 0; i < 3; i++) {
            cur_enemy[i].x += cur_enemy[i].add_x;
            if (cur_enemy[i].x <= -16) {
              cur_enemy[i].add_x = 0;
              if (enemy_count > 0) {
                enemy_count--;
              } else {
                if (random(255) % 8 == 0) {
                  enemy_count = stage_conf[now_stage].enemy_hindo;
                  cur_enemy[i].x    = 128;
                  cur_enemy[i].add_x = -3;
                }
              }
            }
            if (cur_enemy[i].x > -16) {
              //当たり判定
              for (int j = 0; j < 20; j++) {
                if (cur_tama[j].x <= -8 || cur_tama[j].x >= 128) {
                } else {
                  if (((cur_enemy[i].x <= (cur_tama[j].x + 2) && (cur_tama[j].x + 2) <= cur_enemy[i].x + 16) ||
                       (cur_enemy[i].x <= (cur_tama[j].x + 6) && (cur_tama[j].x + 6) <= cur_enemy[i].x + 16)) &&
                      ((cur_enemy[i].y <= (cur_tama[j].y + 2) && (cur_tama[j].y + 2) <= cur_enemy[i].y + 16) ||
                       (cur_enemy[i].y <= (cur_tama[j].y + 6) && (cur_tama[j].y + 6) <= cur_enemy[i].y + 16))) {
                    cur_enemy[i].x = -16; // 画面から消す
                    cur_enemy[i].add_x = 0; // 画面から消す
                    cur_tama[j].x = -8;
                    cur_tama[j].add_x = 0;
                  }
                }
              }
            }
            if (cur_enemy[i].x > -16) {
              if (((cur_enemy[i].x <= (cur.x + 2) && (cur.x + 2) <= cur_enemy[i].x + 16) ||
                   (cur_enemy[i].x <= (cur.x + 22) && (cur.x + 22) <= cur_enemy[i].x + 16)) &&
                  ((cur_enemy[i].y <= (cur.y + 2) && (cur.y + 2) <= cur_enemy[i].y + 16) ||
                   (cur_enemy[i].y <= (cur.y + 14) && (cur.y + 14) <= cur_enemy[i].y + 16))) {
                state = state_game_over_enemy;
              }
            }
            if (cur_enemy[i].x > -16) {
              int enemy_move;
              enemy_move = random(255) % 2;
              display.drawBitmap(cur_enemy[i].x, cur_enemy[i].y, bitmap_enemy[enemy_move][0], 16, 8, 1);
              display.drawBitmap(cur_enemy[i].x, cur_enemy[i].y + 8, bitmap_enemy[enemy_move][1], 16, 8, 1);
            }
          }
          break;
        case state_game_aft:
          display.drawBitmap(wakusei_x * 2 - 128 * 2   , 0,      bitmap_star_man[0], 128, 64, 1);
          display.drawBitmap(wakusei_x * 2 - 128   , 0,      bitmap_star_man[1], 128, 64, 1);
          display.drawBitmap(wakusei_x * 2      , 0,      bitmap_star_man[0], 128, 64, 1);
          display.drawBitmap(wakusei_x * 3 - 128 * 3, 0,      bitmap_star[1], 128, 64, 1);
          display.drawBitmap(wakusei_x * 3 - 128 * 2, 0,      bitmap_star[0], 128, 64, 1);
          display.drawBitmap(wakusei_x * 3 - 128, 0,      bitmap_star[1], 128, 64, 1);
          display.drawBitmap(wakusei_x * 3      , 0,      bitmap_star[0], 128, 64, 1);

          display.drawBitmap(wakusei_x, 0, bitmap_wakusei[stage_conf[now_stage].goal_wakusei], 128, 64, 1);

          display.drawBitmap(cur.x, cur.y, bitmap_fighter[0], 24, 8, 0);
          display.drawBitmap(cur.x, cur.y + 8, bitmap_fighter[1], 24, 8, 0);
          display.drawBitmap(cur.x, cur.y, bitmap_fighter[2], 24, 8, 1);
          display.drawBitmap(cur.x, cur.y + 8, bitmap_fighter[3], 24, 8, 1);

          if (gun_enable) {
            if (tama_kakudo > 0) {
              display.drawBitmap(cur.x, cur.y, bitmap_gun[0][0], 24, 8, 0);
              display.drawBitmap(cur.x, cur.y + 8, bitmap_gun[0][1], 24, 8, 0);
              display.drawBitmap(cur.x, cur.y, bitmap_gun[0][2], 24, 8, 1);
              display.drawBitmap(cur.x, cur.y + 8, bitmap_gun[0][3], 24, 8, 1);
            } else {
              display.drawBitmap(cur.x, cur.y, bitmap_gun[1][0], 24, 8, 0);
              display.drawBitmap(cur.x, cur.y + 8, bitmap_gun[1][1], 24, 8, 0);
              display.drawBitmap(cur.x, cur.y, bitmap_gun[1][2], 24, 8, 1);
              display.drawBitmap(cur.x, cur.y + 8, bitmap_gun[1][3], 24, 8, 1);
            }
          }

          if (wakusei_x > 0) {
            wakusei_x -= 3;
          } else {
            if (cur.x < 128) {
              cur.x += 7;
            }
            else {
              display.setCursor(0, 64 - 8);
              switch (now_stage) {
                case 0: display.print(F("Uranus")); break;
                case 1: display.print(F("Saturn")); break;
                case 2: display.print(F("Jupiter")); break;
                case 3: display.print(F("Mars")); break;
                case 4: display.print(F("Earth")); break;
              }

              display.setCursor(0, 28);  display.print(F("CLEAR"));

              if (input & B_BUTTON) {
                now_push_b = true;
              } else {
                if (now_push_b) {
                  now_push_b = false;
                  now_stage++;
                  for (int i = 0; i < 20; i++) {
                    cur_tama[i].x = -8;
                    cur_tama[i].add_x = 0;
                    cur_tama[i].y = 0;
                  }
                  for (int i = 0; i < 3; i++) {
                    cur_enemy[i].x = -16;
                    cur_enemy[i].add_x = 0;
                    cur_enemy[i].y = 8 + i * 16;
                  }
                  distance_x_man = stage_conf[now_stage].man;
                  distance_x_oku = stage_conf[now_stage].oku;
                  distance_x     = 0;
                  cur.x = 8;
                  cur.y = 24;
                  cur.add_x = 0;
                  cur.add_x_man = 0;
                  cur.add_y = 0;
                  cur_star.add_x = stage_conf[now_stage].start_add_x;
                  cur_star.add_x_man = 0;
                  wakusei_x = 0;
                  jet_kosyo = stage_conf[now_stage].jet_kosyo;
                  enemy_count = 150;
                  gun_enable = stage_conf[now_stage].gun;
                  tama_kakudo = 3;
                  tama_count = 99;

                  state = state_game_bef;
                }
              }
            }
          }
          break;
        case state_game_over_speed:
          display.drawBitmap(0, 0, bitmap_bakuhatu, 128, 64, 1);
          display.setCursor(32, 24);  display.print(F("GAME OVER"));
          display.setCursor(20, 32);  display.print(F("Planet Breaks !!"));
          if (input & B_BUTTON) {
            now_push_b = true;
          } else {
            if (now_push_b) {
              now_push_b = false;
              state = state_menu;
            }
          }
          break;
        case state_game_over_enemy:
          display.drawBitmap(0, 0, bitmap_boss, 128, 64, 1);
          display.setCursor(32, 28);  display.print(F("GAME OVER"));
          if (input & B_BUTTON) {
            now_push_b = true;
          } else {
            if (now_push_b) {
              now_push_b = false;
              state = state_menu;
            }
          }
          break;
        case state_game_clear:
          display.drawBitmap(0, 0, bitmap_wakusei[5], 128, 64, 1);
          display.setCursor(0, 28);  display.print(F(" You saved the earth"));
          if (input & B_BUTTON) {
            now_push_b = true;
          } else {
            if (now_push_b) {
              now_push_b = false;
              now_stage = 0;
              state = state_menu;
            }
          }
          break;
      }
      display.display();
    }
  }
}

